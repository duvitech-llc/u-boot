## arch/arm/cpu/armv7/omap4/Kconfig
```kconfig
if OMAP44XX

choice
	prompt "OMAP4 board select"
	optional

config TARGET_DUOVERO
	bool "OMAP4430 Gumstix Duovero"

config TARGET_OMAP4_PANDA
	bool "TI OMAP4 PandaBoard"
	
config TARGET_OMAP4_M100
	bool "Vuzix OMAP4 M100"
	
config TARGET_OMAP4_SDP4430
	bool "TI OMAP4 SDP4430"

endchoice

config SYS_SOC
	default "omap4"

source "board/gumstix/duovero/Kconfig"
source "board/ti/panda/Kconfig"
source "board/vuzix/m100/Kconfig"
source "board/ti/sdp4430/Kconfig"

endif
```

## board/vuzix/m100/Kconfig
```kconfig
if TARGET_OMAP4_M100

config SYS_BOARD
	default "m100"

config SYS_VENDOR
	default "vuzix"

config SYS_CONFIG_NAME
	default "omap4_m100"

endif
```
